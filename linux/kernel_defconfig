## linux/kernel_defconfig
```kconfig
# Linux Kernel 6.6+ Minimal Configuration for SMVDU TITAN-X SoC (RV64GC)
CONFIG_64BIT=y
CONFIG_ARCH_RV64I=y
CONFIG_RISCV=y
CONFIG_SMP=y
CONFIG_NR_CPUS=4
CONFIG_RISCV_SBI=y
CONFIG_PAGE_OFFSET=0xffffffe000000000
CONFIG_HZ_100=y
CONFIG_CMDLINE="console=ttyS0,115200 earlycon=uart8250,mmio32,0x10000000 root=/dev/ram0 rdinit=/sbin/init rw"
CONFIG_CMDLINE_EXTEND=y

# Device Tree
CONFIG_OF=y
CONFIG_OF_EARLY_FLATTREE=y

# Memory & Caches
CONFIG_MMU=y
CONFIG_VA_BITS_39=y
CONFIG_FLATMEM_MANUAL=y

# Core Drivers
CONFIG_SERIAL_8250=y
CONFIG_SERIAL_8250_CONSOLE=y
CONFIG_SERIAL_8250_NR_UARTS=4
CONFIG_SERIAL_OF_PLATFORM=y
CONFIG_SERIAL_EARLYCON=y
CONFIG_SERIAL_EARLYCON_RISCV_SBI=y

# Interrupt Controllers
CONFIG_RISCV_INTC=y
CONFIG_SIFIVE_PLIC=y
CONFIG_SIFIVE_CLINT=y

# Timers & RTC
CONFIG_RISCV_TIMER=y
CONFIG_RTC_CLASS=y
CONFIG_RTC_DRV_GOLDFISH=y

# RAM Disk / Initramfs
CONFIG_BLK_DEV_INITRD=y
CONFIG_RD_GZIP=y
CONFIG_BLK_DEV_RAM=y
CONFIG_BLK_DEV_RAM_COUNT=4
CONFIG_BLK_DEV_RAM_SIZE=32768

# File Systems
CONFIG_EXT4_FS=y
CONFIG_TMPFS=y
CONFIG_DEVTMPFS=y
CONFIG_DEVTMPFS_MOUNT=y
CONFIG_PROC_FS=y
CONFIG_SYSFS=y

# Networking (Phase 2)
CONFIG_NET=y
CONFIG_INET=y
CONFIG_NET_ETHERNET=y
CONFIG_MACB=y
```
